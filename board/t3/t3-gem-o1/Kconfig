## board/t3/t3-gem-o1/Kconfig
```kconfig
# SPDX-License-Identifier: GPL-2.0+
#
# Copyright (C) 2025 Texas Instruments Incorporated - https://www.ti.com/
#

if TARGET_J722S_R5_T3_GEM_O1 || TARGET_J722S_A53_T3_GEM_O1

config SYS_BOARD
       default "t3-gem-o1"

config SYS_VENDOR
       default "t3"

config SYS_CONFIG_NAME
       default "t3_gem_o1"

source "board/ti/common/Kconfig"

endif

if TARGET_J722S_R5_T3_GEM_O1

config SPL_LDSCRIPT
	default "arch/arm/mach-omap2/u-boot-spl.lds"

endif
```

## configs/am67a_t3_gem_o1_a53_defconfig
```kconfig
#include <configs/j722s_evm_a53_defconfig>

CONFIG_ARM=y
CONFIG_ARCH_K3=y
CONFIG_SOC_K3_J722S=y
CONFIG_TARGET_J722S_A53_T3_GEM_O1=y

CONFIG_DEFAULT_DEVICE_TREE="ti/k3-am67a-t3-gem-o1"
CONFIG_SPL_OF_LIST="ti/k3-am67a-t3-gem-o1"
CONFIG_OF_LIST="ti/k3-am67a-t3-gem-o1"

CONFIG_BOOTCOMMAND="run distro_bootcmd"
CONFIG_SYS_MALLOC_LEN=0x2000000
CONFIG_EXT4_WRITE=y
CONFIG_LZO=y
CONFIG_AUTOBOOT_KEYED=y
CONFIG_AUTOBOOT_PROMPT="Press SPACE to abort autoboot in %d seconds\n"
CONFIG_AUTOBOOT_DELAY_STR="d"
CONFIG_AUTOBOOT_STOP_STR=" "
CONFIG_TI_I2C_BOARD_DETECT=n
CONFIG_SPL_SPI=n
CONFIG_SPL_SPI_FLASH_SUPPORT=n
CONFIG_SPL_DM_SPI_FLASH=n
CONFIG_SPL_MTD_SUPPORT=n
CONFIG_DM_SPI_FLASH=n
CONFIG_SPI_FLASH=n
CONFIG_MTD=n
CONFIG_MTD_PARTITIONS=n
CONFIG_DM_MTD=n
CONFIG_MTD_UBI=n
CONFIG_CMD_UBIFS=n
CONFIG_CMD_UBI=n
CONFIG_DFU_SF=n
CONFIG_DM_SPI=n
CONFIG_SPL_SPI_LOAD=n
CONFIG_SPL_MTD=n
CONFIG_CMD_SPI=n
CONFIG_SYSCON=y
CONFIG_SPL_SYSCON=y
CONFIG_MISC=y
CONFIG_USB_COMMON=y
CONFIG_USB_XHCI_PCI=y
CONFIG_USB_XHCI_PLATFORM=y
CONFIG_USB_STORAGE=y
CONFIG_USB_DWC3_AM62=y
CONFIG_SPL_USB_DWC3_AM62=y
CONFIG_TYPEC_TPS6598X=y
CONFIG_USB_ROLE_SWITCH=y
CONFIG_TYPEC=y
CONFIG_USB_GADGET_DOWNLOAD=y
CONFIG_SPL_RAW_IMAGE_SUPPORT=y
CONFIG_MMC=y
CONFIG_MMC_WRITE=y
CONFIG_CMD_MMC=y
CONFIG_ENV_IS_NOWHERE=y
CONFIG_ENV_OVERWRITE=y
```

## configs/am67a_t3_gem_o1_r5_defconfig
```kconfig
#include <configs/j722s_evm_r5_defconfig>

CONFIG_ARM=y
CONFIG_ARCH_K3=y
CONFIG_SOC_K3_J722S=y
CONFIG_TARGET_J722S_R5_T3_GEM_O1=y

CONFIG_DEFAULT_DEVICE_TREE="k3-am67a-r5-t3-gem-o1"
CONFIG_SPL_OF_LIST="k3-am67a-r5-t3-gem-o1"
CONFIG_OF_LIST="k3-am67a-r5-t3-gem-o1"

CONFIG_TI_I2C_BOARD_DETECT=n
CONFIG_SPL_DM_SPI_FLASH=n
CONFIG_SPL_MTD_SUPPORT=n

CONFIG_SPL_SIZE_LIMIT=0x48000
CONFIG_USB=y
CONFIG_USB_DWC3=y
CONFIG_USB_DWC3_GENERIC=y
CONFIG_USB_DWC3_AM62=y
CONFIG_USB_GADGET=y
CONFIG_USB_GADGET_MANUFACTURER="Texas Instruments"
CONFIG_USB_GADGET_VENDOR_NUM=0x0451
CONFIG_USB_GADGET_PRODUCT_NUM=0x6165
CONFIG_USB_GADGET_DOWNLOAD=y
CONFIG_SPL_DM_USB_GADGET=y
CONFIG_SPL_USB_GADGET=y
CONFIG_SPL_USB_DWC3_GENERIC=y
CONFIG_SPL_USB_DWC3_AM62=y
CONFIG_SPL_DFU=y
CONFIG_SYS_DFU_DATA_BUF_SIZE=0x40000
CONFIG_DM_USB_GADGET=y
CONFIG_SPL_ENV_SUPPORT=y
CONFIG_SYSCON=y
CONFIG_SPL_SYSCON=y
CONFIG_MMC=y
CONFIG_MMC_SDHCI_K3=y
CONFIG_SPL_MMC_SDHCI=y
CONFIG_SPL_MMC_SDHCI_K3=y
```
